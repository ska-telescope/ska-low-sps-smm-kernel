## drivers/media/platform/mxc/capture/Kconfig
```kconfig
if VIDEO_MXC_CAPTURE
config VIDEO_V4L2_MXC_INT_DEVICE
       tristate

menu "MXC Camera/V4L2 PRP Features support"
config VIDEO_MXC_IPU_CAMERA
	bool
	select VIDEO_V4L2_MXC_INT_DEVICE
	depends on VIDEO_MXC_CAPTURE && MXC_IPU
	default y

config SANITAS_INVENTAMI_VIDEO_CH
    tristate "Sanitas Inventami Input Video Channel Driver"
    depends on !VIDEO_MXC_EMMA_CAMERA
	---help---
	  If you plan to use the NXP tda1997x/tdf1997x HDMI reciever with your i

    ---help---
      If you plan to use the Sanitas Inventami Input Video Channel Driver, say Y here.

config SANITAS_INVENTAMI_VIDEO_OUT
    tristate "Sanitas Inventami Video Output Driver"
    depends on !VIDEO_MXC_EMMA_CAMERA
    ---help---
      If you plan to use the Sanitas Inventami Video Output Driver, say Y here.

config SANITAS_MXC_V4L2_CSI
	tristate "Sanitas Inventami camera support using i.MX6 parallel port"
	depends on !VIDEO_MXC_EMMA_CAMERA && I2C && SPI_MASTER
	---help---
	  If you plan to use the Sanitas Inventami Camera with parallel port interface in your Inventami system, say Y here.

config SANITAS_MXC_V4L2_MIPI
	tristate "Sanitas Inventami camera support using i.MX6 MIPI port"
	depends on !VIDEO_MXC_EMMA_CAMERA && I2C && SPI_MASTER
	---help---
	  If you plan to use the Sanitas Inventami Camera with MIPI interface in your Inventami system, say Y here.

config SANITAS_CMV4000
	tristate "Sanitas CMV4000 sensor/frontend SPI driver"
	depends on SPI_MASTER
	---help---
	  If you plan to use the CMOSIS CMV4000 in your system, say Y here.

config SANITAS_MT9P031
	tristate "Sanitas MT9P031 sensor/frontend SPI driver"
	depends on SPI_MASTER
	---help---
	  If you plan to use the Aptina MT9P031 in your system, say Y here.

config SANITAS_INVENTAMI_COLORBAR
	tristate "Sanitas colorbar generator driver"
	depends on !VIDEO_MXC_EMMA_CAMERA
	---help---
	  If you plan to use the Colorbar Generator, say Y here. Please note that there's no use of i2c... It's just for compatibility with other sources.

choice
	prompt "Select Overlay Rounting"
	default MXC_IPU_DEVICE_QUEUE_SDC
	depends on VIDEO_MXC_IPU_CAMERA && FB_MXC_SYNC_PANEL

config MXC_IPU_DEVICE_QUEUE_SDC
	tristate "Queue ipu device for overlay library"
	depends on VIDEO_MXC_IPU_CAMERA
	---help---
	  Use case CSI->MEM->IPU DEVICE->SDC:
		Images from sensor will be frist recieved in memory,then
		queue to ipu device for processing if needed, and displaying
		it on synchronous display with SDC use case.

config MXC_IPU_PRP_VF_SDC
	bool "Pre-Processor VF SDC library"
	depends on VIDEO_MXC_IPU_CAMERA
	---help---
	  Use case PRP_VF_SDC:
		Preprocessing image from smart sensor for viewfinder and
		displaying it on synchronous display with SDC use case.
		If SDC BG is selected, Rotation will not be supported.
		CSI -> IC (PRP VF) -> MEM
		MEM -> IC (ROT) -> MEM
		MEM -> SDC (FG/BG)

endchoice

config MXC_IPU_PRP_ENC
	tristate "Pre-processor Encoder library"
	depends on VIDEO_MXC_IPU_CAMERA
	default y
	---help---
	  Use case PRP_ENC:
		Preprocessing image from smart sensor for encoder.
		CSI -> IC (PRP ENC) -> MEM

config MXC_IPU_CSI_ENC
	tristate "IPU CSI Encoder library"
	depends on VIDEO_MXC_IPU_CAMERA
	default y
	---help---
	  Use case IPU_CSI_ENC:
		Get raw image with CSI from smart sensor for encoder.
		CSI -> MEM
endmenu

endif
```

## drivers/misc/sanitas/Kconfig
```kconfig
#
# Sanitas Miscellanous stuff
#
menu "Sanitas Miscellanous stuff"

config SANITAS_SKA_MNG_FPGA
	tristate "Sanitas Ska Management FPGA driver"
	depends on IMX_WEIM
	help
	  This enables the Sanitas SKA Management FPGA driver. Individual devices
	  drivers must be individually configured.

config SANITAS_SKA_MNG_USERREG
	tristate "Sanitas SKA Management User Registers driver"
	depends on IMX_WEIM
	help
	  This enables the Sanitas SKA Management User Registers driver. Individual devices
	  drivers must be individually configured.

config SANITAS_SKA_MNG_LED
	tristate "Sanitas SKA Management Leds driver"
	depends on IMX_WEIM
	help
	  This enables the Sanitas SKA Management Leds driver. Individual devices
	  drivers must be individually configured.

config SANITAS_SKA_MNG_ONEWIREREGS
	tristate "Sanitas SKA Management OneWire Register driver"
	depends on IMX_WEIM
	help
	  This enables the Sanitas SKA Management Onewire driver. Individual devices
	  drivers must be individually configured.

config SANITAS_SKA_MNG_MDIO
	tristate "Sanitas SKA Management MDIO driver"
	depends on IMX_WEIM
	help
	  This enables the Sanitas SKA Management MDIO driver. Individual devices
	  drivers must be individually configured.

config SANITAS_SKA_MNG_ETHREGS
	tristate "Sanitas SKA Management ETH Registers driver"
	depends on IMX_WEIM
	help
	  This enables the Sanitas SKA Management ETH Registers driver. Individual devices
	  drivers must be individually configured.


config SANITAS_SKA_MNG_LOCKREGS
	tristate "Sanitas SKA Management LOCK Registers driver"
	depends on IMX_WEIM
	help
	  This enables the Sanitas SKA Management LOCK Registers driver. Individual devices
	  drivers must be individually configured.

config SANITAS_SKA_MNG_HKREGS
	tristate "Sanitas SKA Management House Keeping Registers driver"
	depends on IMX_WEIM
	help
	  This enables the Sanitas SKA Management House Keeping Registers driver. Individual devices
	  drivers must be individually configured.

config SANITAS_SKA_MNG_FRAMREGS
	tristate "Sanitas SKA Management Fpga Ram  Registers driver"
	depends on IMX_WEIM
	help
	  This enables the Sanitas SKA Management Fpga Ram Registers driver. Individual devices
	  drivers must be individually configured.

config SANITAS_SKA_MNG_FPGA_I2C
	tristate "Sanitas SKA Management Fpga I2C  Registers driver"
	depends on IMX_WEIM
	help
	  This enables the Sanitas SKA Management Fpga I2C Registers driver. Individual devices
	  drivers must be individually configured.

config SANITAS_SKA_MNG_MCUREGS
	tristate "Sanitas SKA Management MCU Registers driver"
	depends on IMX_WEIM
	help
	  This enables the Sanitas SKA Management MCU Registers driver. Individual devices
	  drivers must be individually configured.
endmenu
```
